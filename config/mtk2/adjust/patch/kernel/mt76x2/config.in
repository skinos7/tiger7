## config/mtk2/adjust/patch/kernel/mt76x2/config.in
```kconfig
choice
    prompt "mt76x2 build type"
    depends on PACKAGE_kmod-mt76x2
    default MT76x2E_BUILD_KO
config  MT76x2E_BUILD_KO
    bool "build as module (mt76x2.ko)"
    select PACKAGE_kmod-mt76x2-ko
config  MT76x2E_BUILD_IN
    bool "build into kernel"
    select PACKAGE_kmod-mt76x2-in
endchoice


# entries start with "KCONFIG" will be applied to kernel.
config  KCONFIG_WIFI_MT76x2E
    bool
    default n

# ---------------- 1st card ----------------
config  KCONFIG_FIRST_IF_MT76x2E
    bool "mt76x2 as 1st card"
    select KCONFIG_WIFI_MT762xE
    default n
config  KCONFIG_RT_FIRST_CARD
    string
    depends on KCONFIG_FIRST_IF_MT76x2E
    default "76x2e"
config  KCONFIG_RT_FIRST_IF_RF_OFFSET
    hex
    depends on KCONFIG_FIRST_IF_MT76x2E
    default 0x0

# ---------------- 2nd card ----------------
config  KCONFIG_SECOND_IF_MT76x2E
    bool "mt76x2 as 2nd card"
    select KCONFIG_WIFI_MT76x2E
    default n
config  KCONFIG_RT_SECOND_CARD
    string
    depends on KCONFIG_SECOND_IF_MT76x2E
    default "76x2e"
config  KCONFIG_RT_SECOND_IF_RF_OFFSET
    hex
    depends on KCONFIG_SECOND_IF_MT76x2E
    default 0x8000
```
